## app/pressed_keys/Kconfig
```kconfig
config PRESSED_KEYS
    bool "Enable pressed-keys display"
    depends on ZMK_DISPLAY
    default y
    help
      Display currently pressed keys on the left OLED screen (128x32).
```

## app/src/display/Kconfig
```kconfig
config ZMK_DISPLAY_STATUS_SCREEN_BUILT_IN
    bool "Built in status screen"
    select LV_OBJ_LABEL
    imply LV_USE_THEME_MONO if LV_Z_BITS_PER_PIXEL=1
    imply ZMK_WIDGET_LAYER_STATUS
    imply ZMK_WIDGET_BATTERY_STATUS
    imply ZMK_WIDGET_OUTPUT_STATUS
    imply ZMK_WIDGET_PERIPHERAL_STATUS
    imply ZMK_WIDGET_INDICATORS_STATUS
```

## src/offsetkey_display/widgets/Kconfig
```kconfig
# Copyright (c) 2020 The ZMK Contributors
# SPDX-License-Identifier: MIT

menu "ZMK Display Widgets INDICATORS_STATUS"

config ZMK_WIDGET_INDICATORS_STATUS
    bool "Widget for displaying HID indicators status"
    depends on (!ZMK_SPLIT || ZMK_SPLIT_ROLE_CENTRAL) && ZMK_DISPLAY
    select LV_USE_LABEL
    select ZMK_HID_INDICATORS

endmenu
```
